## Kconfig
```kconfig
config SECURITY_HONEYBEST
	tristate "New implementation of Linux security module"
	depends on SECURITY
	help
	  Any files read through the kernel file reading interface
	  (kernel modules, firmware, kexec images, security policy)
	  can be pinned to the first filesystem used for loading. When
	  enabled, any files that come from other filesystems will be
	  rejected. This is best used on systems without an initrd that
	  have a root filesystem backed by a read-only device such as
	  dm-verity or a CDROM.

config SECURITY_HONEYBEST_ENABLED
	bool "Enforce HoneyBest at boot"
	depends on SECURITY_HONEYBEST
	help
	  If selected, HoneyBest will enforce pinning at boot. If not
	  selected, it can be enabled at boot with the kernel parameter
	  "honeybest.enabled=1".

config SECURITY_HONEYBEST_PROD
	bool "Lock down HoneyBest locking option"
	depends on SECURITY_HONEYBEST
	help
	  If selected, HoneyBest locking option will not be reversabled
	  once set to enable.
```
